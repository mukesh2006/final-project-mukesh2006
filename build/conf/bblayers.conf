## build/conf/bblayers.conf
```bitbake
# POKY_BBLAYERS_CONF_VERSION is increased each time build/conf/bblayers.conf
# changes incompatibly
POKY_BBLAYERS_CONF_VERSION = "2"

BBPATH = "${TOPDIR}"
BBFILES ?= ""

BBLAYERS ?= " \
  /home/mj/Downloads/mj-personal/git/final-project/final-project-mukesh2006/poky/meta \
  /home/mj/Downloads/mj-personal/git/final-project/final-project-mukesh2006/poky/meta-poky \
  /home/mj/Downloads/mj-personal/git/final-project/final-project-mukesh2006/poky/meta-yocto-bsp \
  /home/mj/Downloads/mj-personal/git/final-project/final-project-mukesh2006/meta-raspberrypi \
  /home/mj/Downloads/mj-personal/git/final-project/final-project-mukesh2006/meta-openembedded/meta-oe \
  /home/mj/Downloads/mj-personal/git/final-project/final-project-mukesh2006/meta-openembedded/meta-multimedia \
  /home/mj/Downloads/mj-personal/git/final-project/final-project-mukesh2006/meta-openembedded/meta-networking \
  /home/mj/Downloads/mj-personal/git/final-project/final-project-mukesh2006/meta-openembedded/meta-webserver \    
  /home/mj/Downloads/mj-personal/git/final-project/final-project-mukesh2006/meta-openembedded/meta-python \
  "
```

## meta-finalproject/conf/layer.conf
```bitbake
# We have a conf and classes directory, add to BBPATH
BBPATH .= ":${LAYERDIR}"

# We have recipes-* directories, add to BBFILES
BBFILES += "${LAYERDIR}/recipes-*/*/*.bb \
            ${LAYERDIR}/recipes-*/*/*.bbappend"

BBFILE_COLLECTIONS += "meta-finalproject"
BBFILE_PATTERN_meta-finalproject = "^${LAYERDIR}/"
BBFILE_PRIORITY_meta-finalproject = "6"

LAYERDEPENDS_meta-finalproject = "core"
LAYERSERIES_COMPAT_meta-finalproject = "kirkstone"
```
